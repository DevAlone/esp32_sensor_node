## main/Kconfig.projbuild
```kconfig
menu "Sensor Network"

config ROUTER_SSID
    string "Router SSID"
        default "ROUTER_SSID"
        help
            Router SSID.

config ROUTER_PASSWORD
    string "Router password"
        default "ROUTER_PASSWORD"
        help
            Router password.

config USE_MESH
    bool "whether to use mesh or not"
        default false
        help
	    enable to use mesh, or disable to use star topology
            
config MESH_ID
    string "Mesh ID"
        default "123456"
        help
            Mesh network identification, Nodes with the same mesh ID can
            communicate with each other. Generate GUID to make it unique.

config MESH_PASSWORD
    string "Mesh Password"
    default "MESH_PASSWORD"
    help
        Mesh AP password. Password length must be 8 bits smaller than 64 bits. Set to null to not encrypt

config LED_GPIO_NUM
    int "LED pin GPIO number"
    range 0 33
    default 25
    help
        There are more enumerations like that
        up to GPIO39, excluding GPIO20, GPIO24 and GPIO28..31.
        They are not shown here to reduce redundant information.
        @note GPIO34..39 are input mode only.

config SERVER_DOMAIN
    string "server domain(ip address and port)"
        default "192.168.0.1"
        help
            Server IP address

config SERVER_USERNAME
    string "Username for server"
        default "user"
        help
            Username for server

config SERVER_PASSWORD
    string "Password for server"
        default "qwerty"
        help
            Password for server

config ALTERNATIVE_SERVER_ENABLED
    bool "send to another server"
        default false
        help
		is alternative client enabled

config ALTERNATIVE_SERVER_DOMAIN
    string "alternative server domain(ip and port)"
        default "192.168.0.1"
        help
            Mqtt alternative server IP address

config ALTERNATIVE_SERVER_USERNAME
    string "username for alternative server"
        default "user"
        help
            Alternative username

config ALTERNATIVE_SERVER_PASSWORD
    string "password for alternative server"
        default "qwerty"
        help
            Alternative password for

config SENSOR_DHT11_ENABLED
    bool "whether this node has dht11 sensor or not"
    default false

config SENSOR_DHT11_PIN
    int "Pin for dht11 sensor if this node has one"
    range 0 33
    default 13

endmenu
```
